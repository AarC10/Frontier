## Kconfig
```kconfig
# Copyright (c) 2024 Aaron Chan
# SPDX-License-Identifier: Apache-2.0

# Note this should be configured by pins
config DEFAULT_RECEIVE_MODE
    bool "Startup defaults to receive mode"
    default n

config GPS_TRANSMIT_INTERVAL
    int "Time interval (in seconds) to transmit GPS data"
    default 5

config TIMESLOT
    int "Time slot (in seconds) to wait before next transmission"
    default 0

config LORA_FREQUENCY
    int "LoRa frequency in Hz"
    default 915000000


rsource "lib/Kconfig"
rsource "drivers/Kconfig"
```

## boards/hunter_gen2/board.yml
```yaml
board:
  name: hunter_gen2
  full_name: Hunter Gen 2
  vendor: Wild West Rocketry
  socs:
    - name: stm32l151xb
```

## boards/marshal/Kconfig.board
```kconfig
# SPDX-License-Identifier: Apache-2.0

config BOARD_MARSHAL
	bool "Marshal"
	select SOC_STM32G474XX
```

## boards/marshal/Kconfig.defconfig
```kconfig
# SPDX-License-Identifier: Apache-2.0

if BOARD_MARSHAL

config SERIAL
	default y

config CONSOLE
	default y

config UART_CONSOLE
	default y

endif
```

## boards/marshal/Kconfig.marshal
```kconfig
# Copyright (c) 2025 Aaron Chan
# SPDX-License-Identifier: Apache-2.0

config BOARD_HUNTER
	select SOC_STM32F030X8
```

## boards/marshal/board.yml
```yaml
board:
  name: marshal
  full_name: Marshal
  vendor: Wild West Rocketry
  revision:
    format: number
    default: "1"
    revisions:
      - name: "1"
      - name: "2"
  socs:
    - name: stm32g474xx
```

## boards/marshal/marshal_defconfig
```kconfig
# SPDX-License-Identifier: Apache-2.0

# Serial
CONFIG_SERIAL=y
CONFIG_UART_INTERRUPT_DRIVEN=y
CONFIG_CONSOLE=y
CONFIG_UART_CONSOLE=y

# USB hardware
CONFIG_USB_DEVICE_STACK_NEXT=y
CONFIG_USBC_STACK=n

# GPIO
CONFIG_GPIO=y

# Clock
CONFIG_SYS_CLOCK_HW_CYCLES_PER_SEC=80000000

# Sensors
CONFIG_SENSOR=y
CONFIG_MS56XX=y
CONFIG_LSM6DSV16X_TRIGGER_OWN_THREAD=y
```

## drivers/Kconfig
```kconfig
# Copyright (c) 2026 Aaron Chan
# SPDX-License-Identifier: Apache-2.0

menu "Drivers"
rsource "rda5807m/Kconfig"
rsource "sensor/Kconfig"
endmenu
```

## drivers/rda5807m/Kconfig
```kconfig
# Copyright (c) 2026 Aaron Chan
# SPDX-License-Identifier: Apache-2.0

menuconfig RDA5807M
	bool "RDA5807M FM Radio Receiver"
	default n
	help
	  Enable driver for the RDA5807M FM radio receiver.
```

## drivers/sensor/Kconfig
```kconfig
# Copyright (c) 2026 Aaron Chan
# SPDX-License-Identifier: Apache-2.0

if SENSOR
rsource "ms56xx/Kconfig"
endif # SENSOR
```

## dts/bindings/radio/rda,rda5807m.yaml
```yaml
description: RDA5807M FM Radio Receiver

compatible: "rda,rda5807m"

include: [base.yaml, i2c-device.yaml]

properties:
  reg:
    required: true

  vol-default:
    type: int
    default: 8
    description: Initial volume (0-15)

  band:
    type: string
    default: "87-108"
    enum:
      - "87-108"
      - "76-91"
      - "76-108"
    description: FM band selection
```

## dts/bindings/sensor/te,ms5607-spi.yaml
```yaml
# Copyright (c) 2024, Aaron Chan
# SPDX-License-Identifier: Apache-2.0

description: |
    TE Connectivity MS5607 digital pressure and temperature sensor.
    The Datasheet is at https://www.te.com/usa-en/product-CAT-BLPS0035.html

compatible: "te,ms5607"

include: ["spi-device.yaml", "te,ms56xx-common.yaml"]
```

## lib/core/Kconfig
```kconfig
config CORE
  bool "Core"
  help
    This option enables core functionality for flight software

if CORE

config CORE_GNSS
  bool "Core GNSS"
  default n
  help
    Build GNSS receiver support in the core library.

config CORE_SETTINGS
  bool "Core Settings"
  default n
  help
    Build settings storage/runtime configuration support in the core library.

config CORE_LORA
  bool "Core LoRa"
  default n
  help
    Build LoRa transceiver support in the core library.

config CORE_TDMA_TIME
  bool "Core TDMA and Time"
  default n
  help
    Build TDMA clock and PPS timekeeping support in the core library.

config CORE_FLIGHT
  bool "Core Flight State Machine"
  default n
  help
    Build flight state machine for rocket state tracking and event detection.


config CORE_FLIGHT_LOGGER
  bool "Core Flight Logging"
  default n
  help
    Build flight logging support for logging flight data to flash storage.

config CORE_SENSORS
  bool "Core Sensor Abstractions"
  default n
  help
    Build sensor abstractions for core sensors like barometers and IMUs.


config LICENSED_FREQUENCY
  bool "Licensed Frequency"
  depends on CORE_SETTINGS
  help
    This option enables callsigns prepended to each packet.

config CORE_SETTINGS
  bool "Common Settings"
  depends on SETTINGS
  depends on SETTINGS_NVS
  help
    NVS-persisted deployment and operational settings.

config CORE_SETTINGS_FLIGHT_COMPUTER
  bool "Core Settings Flight Computer"
  depends on CORE_SETTINGS
  help
    This option enables a shell command to set the flight computer at runtime.

config CORE_SETTINGS_TRACKER
  bool "Core Settings Tracker"
  depends on CORE_SETTINGS
  help
    This option enables a shell command to set the tracker at runtime.

config SHELL_FREQUENCY
  bool "Shell Frequency"
  depends on CORE_SETTINGS
  help
    This option enables a shell command to set the frequency at runtime.

config SHELL_CALLSIGN
  bool "Shell Callsign"
  depends on CORE_SETTINGS
  help
    This option enables a shell command to set the callsign at runtime.

config SHELL_NODE_ID
  bool "Shell Node ID"
  depends on CORE_SETTINGS
  help
    This option enables a shell command to set the node ID at runtime.

endif # CORE
```
